## config/boards/shields/zzkb/Kconfig.defconfig
```kconfig
# Copyright (c) 2021 The ZMK Contributors
# SPDX-License-Identifier: MIT

if SHIELD_ZZKB

config ZMK_KEYBOARD_NAME
    default "zzkb"

endif
```

## zmk-config/config/boards/shields/ake_eval/Kconfig.defconfig
```kconfig
# Copyright (c) 2021 The ZMK Contributors
# SPDX-License-Identifier: MIT

if SHIELD_AKE_EVAL

config ZMK_KEYBOARD_NAME
    default "ake_eval"

endif
```

## zmk-config/config/boards/shields/d3kb/Kconfig.defconfig
```kconfig
# Copyright (c) 2021 The ZMK Contributors
# SPDX-License-Identifier: MIT

if SHIELD_D3KB_LEFT

config ZMK_KEYBOARD_NAME
    default "d3kb"

config ZMK_SPLIT_ROLE_CENTRAL
    default y

endif


if SHIELD_D3KB_LEFT || SHIELD_D3KB_RIGHT

config ZMK_SPLIT
    default y

endif


if ZMK_BACKLIGHT

config PWM
    default y

config LED_PWM
    default y

endif # ZMK_BACKLIGHT
```

## zmk-config/config/boards/shields/d3kb/Kconfig.shield
```kconfig
# Copyright (c) 2021 The ZMK Contributors
# SPDX-License-Identifier: MIT

config SHIELD_D3KB_LEFT
    def_bool $(shields_list_contains,d3kb_left)

config SHIELD_D3KB_RIGHT
    def_bool $(shields_list_contains,d3kb_right)
```
